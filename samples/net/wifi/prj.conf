## CMakeLists.txt
```
# SPDX-License-Identifier: Apache-2.0

cmake_minimum_required(VERSION 3.20.0)

find_package(Zephyr REQUIRED HINTS $ENV{ZEPHYR_BASE})
project(wifi)

FILE(GLOB app_sources src/*.c)
target_sources(app PRIVATE ${app_sources})

set(gen_dir ${ZEPHYR_BINARY_DIR}/include/generated/)

foreach(inc_file
	ca.der
	device.der
	device_key.der
    )
  generate_inc_file_for_target(
    app
    src/test_mosquitto_org/${inc_file}
    ${gen_dir}/${inc_file}.inc
    )
endforeach()

add_subdirectory(modules/mqtt_service)
```

## Kconfig
```
mainmenu "Wifi sample configuration"

rsource "modules/mqtt_service/Kconfig"

source "Kconfig.zephyr"
```

## prj.conf
```kconfig
CONFIG_EARLY_CONSOLE=y

CONFIG_LOG_PROCESS_THREAD_SLEEP_MS=100
CONFIG_LOG_BUFFER_SIZE=8192

CONFIG_NETWORKING=y
CONFIG_TEST_RANDOM_GENERATOR=y

CONFIG_NET_TX_STACK_SIZE=2048
CONFIG_NET_RX_STACK_SIZE=2048

CONFIG_NET_PKT_RX_COUNT=10
CONFIG_NET_PKT_TX_COUNT=10
CONFIG_NET_BUF_RX_COUNT=20
CONFIG_NET_BUF_TX_COUNT=20
CONFIG_NET_MAX_CONTEXTS=10
CONFIG_NET_DHCPV4=y

CONFIG_DNS_RESOLVER=y

CONFIG_NET_IPV4=y
CONFIG_NET_IPV6=n

CONFIG_NET_TCP=y

CONFIG_NET_LOG=y
CONFIG_INIT_STACKS=y

CONFIG_NET_SHELL=y

CONFIG_NET_STATISTICS=y
CONFIG_NET_STATISTICS_PERIODIC_OUTPUT=n

CONFIG_WIFI=y
CONFIG_NET_L2_WIFI_SHELL=y

CONFIG_WIFI_LOG_LEVEL_DBG=y
#CONFIG_NET_L2_ETHERNET_LOG_LEVEL_DBG=y
#CONFIG_NET_PKT_LOG_LEVEL_DBG=y
#CONFIG_NET_IPV4_LOG_LEVEL_DBG=y
#CONFIG_NET_DHCPV4_LOG_LEVEL_DBG=y
#CONFIG_NET_L2_WIFI_MGMT_LOG_LEVEL_DBG=y

CONFIG_HWINFO=y

CONFIG_MINIMAL_LIBC_MALLOC_ARENA_SIZE=8192

CONFIG_SYSTEM_WORKQUEUE_STACK_SIZE=4096
CONFIG_SHELL_STACK_SIZE=4096

# MQTT TLS
CONFIG_MAIN_STACK_SIZE=4096
CONFIG_MQTT_LIB_TLS=y
CONFIG_NET_SOCKETS_SOCKOPT_TLS=y

# TLS configuration
CONFIG_MBEDTLS=y
CONFIG_MBEDTLS_BUILTIN=y
CONFIG_MBEDTLS_ENABLE_HEAP=y
CONFIG_MBEDTLS_HEAP_SIZE=32768
CONFIG_MBEDTLS_SSL_MAX_CONTENT_LEN=5120

CONFIG_MQTT_SERVICE=y
CONFIG_MQTT_SERVICE_LOG_LEVEL_DBG=y

CONFIG_NET_MGMT_EVENT_STACK_SIZE=2048
CONFIG_NET_MGMT_EVENT_QUEUE_SIZE=20

# test.mosquitto.org
CONFIG_MQTT_SERVICE_SERVER_DOMAIN_NAME="test.mosquitto.org"
CONFIG_MQTT_SERVICE_SERVER_FALLBACK_IP_ADDRESS="91.121.93.94"
CONFIG_MQTT_SERVICE_SERVER_PORT=8884
```

## boards/esp32.conf
```kconfig
# ESP32 board settings

CONFIG_HEAP_MEM_POOL_SIZE=8192
CONFIG_NET_L2_ETHERNET=y
CONFIG_ESP32_WIFI_STA_AUTO_DHCPV4=y
```

## boards/esp32c3_devkitm.conf
```kconfig
CONFIG_HEAP_MEM_POOL_SIZE=98304
CONFIG_NET_L2_ETHERNET=y
CONFIG_ESP32_WIFI_STA_AUTO_DHCPV4=y
```

## src/mqtt_shell.c
```c
/*
 *
 * SPDX-License-Identifier: Apache-2.0
 *
 */
#include <ctype.h>
#include <stdio.h>
#include <stdlib.h>
#include <string.h>

#include <zephyr/init.h>
#include <zephyr/logging/log.h>
#include <zephyr/shell/shell.h>
#include <zephyr/sys/printk.h>

#include <zephyr/net/socket.h>
#include <zephyr/net/mqtt.h>

#include <mqtt_service.h>

#define LOG_LEVEL CONFIG_LOG_DEFAULT_LEVEL

LOG_MODULE_REGISTER(mqtt_shell);

static int cmd_mqtt_connect(const struct shell *sh, size_t argc, char **argv)
{
	int ret = mqtt_service_connect();
	if(ret)
	{
		shell_error(sh, "Failed to connect to mqtt server, err: %d", ret);
	}

	return 0;
}

static int cmd_mqtt_disconnect(const struct shell *sh, size_t argc, char **argv)
{
	int ret = mqtt_service_disconnect();
	if(ret)
	{
		shell_error(sh, "Failed to disconnect from mqtt server, err: %d", ret);
	}

	return 0;
}

static int cmd_mqtt_publish(const struct shell *sh, size_t argc, char **argv)
{
	uint8_t qos = 0;

	if(argc > 3)
	{
		qos = atoi(argv[3]);

		if(qos < 0 || qos > 2)
		{
			shell_error(sh, "QoS should be in range [0,2]");
			return -EINVAL;
		}
	}

	shell_info(sh, "Publishing %s to %s topic with QoS: %d",
		argv[2], argv[1], qos);

	mqtt_service_publish(argv[1], strlen(argv[1]), argv[2], strlen(argv[2]),
		qos);

	return 0;
}

static int cmd_mqtt_subscribe(const struct shell *sh, size_t argc, char **argv)
{
	uint8_t qos = 0;

	if(argc > 2)
	{
		qos = atoi(argv[2]);

		if(qos < 0 || qos > 2)
		{
			shell_error(sh, "QoS should be in range [0,2]");
			return -EINVAL;
		}
	}

	shell_info(sh, "Subscribing to %s topic with QoS: %d", argv[1], qos);

	mqtt_service_subscribe(argv[1], strlen(argv[1]), qos);

	return 0;
}

static int cmd_mqtt_unsubscribe(const struct shell *sh, size_t argc, char **argv)
{
	shell_info(sh, "Unsubscribing from %s topic.", argv[1]);

	mqtt_service_unsubscribe(argv[1], strlen(argv[1]));

	return 0;
}

SHELL_STATIC_SUBCMD_SET_CREATE(
	sub_mqtt_shell,

	SHELL_CMD_ARG(connect, NULL, "Connect MQTT", cmd_mqtt_connect, 1, 0),
	SHELL_CMD_ARG(disconnect, NULL, "Disconnect MQTT", cmd_mqtt_disconnect, 1, 0),
	SHELL_CMD_ARG(publish, NULL, "Publish to mqtt topic", cmd_mqtt_publish, 3, 1),
	SHELL_CMD_ARG(subscribe, NULL, "Subscribe to mqtt topic", cmd_mqtt_subscribe, 2, 1),
	SHELL_CMD_ARG(unsubscribe, NULL, "Unsubscribe to mqtt topic", cmd_mqtt_unsubscribe, 2, 0),

	SHELL_SUBCMD_SET_END /* Array terminated. */
);

SHELL_CMD_REGISTER(mqtt, &sub_mqtt_shell, "mqtt commands", NULL);
```

## src/wifi_test.c
```c
/*
 * Copyright (c) 2016 Intel Corporation.
 *
 * SPDX-License-Identifier: Apache-2.0
 */

#include <zephyr/kernel.h>
#include <errno.h>

#include <zephyr/net/net_if.h>
#include <zephyr/net/wifi_mgmt.h>
#include <zephyr/net/net_event.h>

#include <mqtt_service.h>

#include <zephyr/logging/log.h>
LOG_MODULE_REGISTER(wifi_sample, LOG_LEVEL_INF);

#define WIFI_SAMPLE_MGMT_EVENTS (NET_EVENT_WIFI_SCAN_RESULT |		\
				NET_EVENT_WIFI_SCAN_DONE |		\
				NET_EVENT_WIFI_CONNECT_RESULT |		\
				NET_EVENT_WIFI_DISCONNECT_RESULT |  \
				NET_EVENT_WIFI_TWT)

static struct net_mgmt_event_callback wifi_sample_mgmt_cb;

static struct {
	const struct shell *sh;

	union {
		struct {

			uint8_t connecting		: 1;
			uint8_t disconnecting	: 1;
			uint8_t _unused		: 6;
		};
		uint8_t all;
	};
} context;

static uint32_t scan_result;


char *net_byte_to_hex_glob(char *ptr, uint8_t byte, char base, bool pad)
{
	int i, val;

	for (i = 0, val = (byte & 0xf0) >> 4; i < 2; i++, val = byte & 0x0f) {
		if (i == 0 && !pad && !val) {
			continue;
		}
		if (val < 10) {
			*ptr++ = (char) (val + '0');
		} else {
			*ptr++ = (char) (val - 10 + base);
		}
	}

	*ptr = '\0';

	return ptr;
}

char *net_sprint_ll_addr_buf_glob(const uint8_t *ll, uint8_t ll_len,
			     char *buf, int buflen)
{
	uint8_t i, len, blen;
	char *ptr = buf;

	if (ll == NULL) {
		return "<unknown>";
	}

	switch (ll_len) {
	case 8:
		len = 8U;
		break;
	case 6:
		len = 6U;
		break;
	case 2:
		len = 2U;
		break;
	default:
		len = 6U;
		break;
	}

	for (i = 0U, blen = buflen; i < len && blen > 0; i++) {
		ptr = net_byte_to_hex_glob(ptr, (char)ll[i], 'A', true);
		*ptr++ = ':';
		blen -= 3U;
	}

	if (!(ptr - buf)) {
		return NULL;
	}

	*(ptr - 1) = '\0';
	return buf;
}


static void handle_wifi_scan_result(struct net_mgmt_event_callback *cb)
{
	const struct wifi_scan_result *entry =
		(const struct wifi_scan_result *)cb->info;
	uint8_t mac_string_buf[sizeof("xx:xx:xx:xx:xx:xx")];

	scan_result++;

	if (scan_result == 1U) {
		LOG_INF(
		      "%-4s | %-32s %-5s | %-13s | %-4s | %-15s | %s",
		      "Num", "SSID", "(len)", "Chan (Band)", "RSSI", "Security", "BSSID");
	}

	LOG_INF("%-4d | %-32s %-5u | %-4u (%-6s) | %-4d | %-15s | %s",
	      scan_result, entry->ssid, entry->ssid_length, entry->channel,
	      wifi_band_txt(entry->band),
	      entry->rssi,
	      wifi_security_txt(entry->security),
	      ((entry->mac_length) ?
		      net_sprint_ll_addr_buf_glob(entry->mac, WIFI_MAC_ADDR_LEN, mac_string_buf,
					     sizeof(mac_string_buf)) : ""));
}

static void handle_wifi_scan_done(struct net_mgmt_event_callback *cb)
{
	const struct wifi_status *status =
		(const struct wifi_status *)cb->info;

	if (status->status) {
		LOG_INF(
		      "Scan request failed (%d)", status->status);
	} else {
		LOG_INF("Scan request done");
	}

	scan_result = 0U;
}


static void handle_wifi_connect_result(struct net_mgmt_event_callback *cb)
{
	const struct wifi_status *status =
		(const struct wifi_status *) cb->info;

	if (status->status) {
		LOG_INF("Connection request failed (%d)", status->status);
	} else {
		LOG_INF("Connected");
	}

	context.connecting = false;
}

static void handle_wifi_disconnect_result(struct net_mgmt_event_callback *cb)
{
	const struct wifi_status *status =
		(const struct wifi_status *) cb->info;

	if (context.disconnecting) {
		LOG_INF(
		      "Disconnection request %s (%d)",
		      status->status ? "failed" : "done",
		      status->status);
		context.disconnecting = false;
	} else {
		LOG_INF("Disconnected");
	}
}

static void handle_wifi_twt_event(struct net_mgmt_event_callback *cb)
{
	const struct wifi_twt_params *resp =
		(const struct wifi_twt_params *)cb->info;

	if (resp->resp_status == WIFI_TWT_RESP_RECEIVED) {
		LOG_INF("TWT response: %s for dialog: %d and flow: %d",
		      wifi_twt_setup_cmd2str[resp->setup_cmd], resp->dialog_token, resp->flow_id);

		/* If accepted, then no need to print TWT params */
		if (resp->setup_cmd != WIFI_TWT_SETUP_CMD_ACCEPT) {
			LOG_INF(
			      "TWT parameters: trigger: %s wake_interval: %d us, interval: %lld us",
			      resp->setup.trigger ? "trigger" : "no_trigger",
			      resp->setup.twt_wake_interval,
			      resp->setup.twt_interval);
		}
	} else {
		LOG_INF("TWT response timed out");
	}
}

static void wifi_mgmt_event_handler(struct net_mgmt_event_callback *cb,
				    uint32_t mgmt_event, struct net_if *iface)
{
	switch (mgmt_event) {
	case NET_EVENT_WIFI_SCAN_RESULT:
		handle_wifi_scan_result(cb);
		break;
	case NET_EVENT_WIFI_SCAN_DONE:
		handle_wifi_scan_done(cb);
		break;
	case NET_EVENT_WIFI_CONNECT_RESULT:
		handle_wifi_connect_result(cb);
		break;
	case NET_EVENT_WIFI_DISCONNECT_RESULT:
		handle_wifi_disconnect_result(cb);
		break;
	case NET_EVENT_WIFI_TWT:
		handle_wifi_twt_event(cb);
		break;
	default:
		break;
	}
}

static void mqtt_service_user_cb(mqtt_service_event_t *evt)
{
    switch(evt->type)
    {
    case MQTT_SERVICE_EVT_CONNECTED:
        LOG_INF("MQTT Client connected!");
        break;

    case MQTT_SERVICE_EVT_DISCONNECTED:
        LOG_WRN("MQTT Client disconnected! Reason: %d", evt->data.disc_reason);
        break;

    case MQTT_SERVICE_EVT_BROKER_ACK:
        LOG_INF("MQTT Broker has acknowledged message, MID = %d",
            evt->data.ack.message_id);
        break;

    case MQTT_SERVICE_EVT_DATA_RECEIVED:
        LOG_INF("Received %d bytes from topic: %.*s",
            evt->data.publish.msg_length,
            evt->data.publish.topic_name_length,
            evt->data.publish.p_topic_name);
        LOG_HEXDUMP_INF(evt->data.publish.p_msg_data,
            evt->data.publish.msg_length, "Message");
        break;

    default:
        LOG_WRN("Uknown event from MQTT service module");
        break;
    }
}


void main(void)
{
	net_mgmt_init_event_callback(&wifi_sample_mgmt_cb,
				     wifi_mgmt_event_handler,
				     WIFI_SAMPLE_MGMT_EVENTS);

	net_mgmt_add_event_callback(&wifi_sample_mgmt_cb);

        int err = 0;

        err = mqtt_service_init(mqtt_service_user_cb);
        if (err) {
                LOG_ERR("Failed to initialize MQTT service");
        }

}
```
